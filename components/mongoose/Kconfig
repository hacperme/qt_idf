## components/network/Kconfig
```kconfig
menu "network configuration"

config NETWORK
    bool "NETWORK"
    depends on DLG
    depends on UTILS
    default n

if NETWORK

    config NETWORK_TCP_ENABLE
        bool "ENANBLE TCP"
        default y

    config MBEDTLS_DYNAMIC_BUFFER
        bool "MBEDTLS DYNAMIC BUFFER"
        depends on MBEDTLS
        default n

    config MBEDTLS_DYNAMIC_FREE_CONFIG_DATA
        bool "MBEDTLS DYNAMIC FREE CONFIG DATA"
        depends on MBEDTLS
        default n

    config MBEDTLS_DYNAMIC_FREE_CA_CERT
        bool "MBEDTLS DYNAMIC FREE CA CERT"
        depends on MBEDTLS
        default n

    config MBEDTLS_SSL_IN_CONTENT_LEN
        int "MBEDTLS SSL IN CONTENT LEN"
        depends on MBEDTLS
        default 16384
        help
            MBEDTLS SSL IN CONTENT LEN

    config MBEDTLS_SSL_OUT_CONTENT_LEN
        int "MBEDTLS SSL OUT CONTENT LEN"
        depends on MBEDTLS
        default 4096
        help
            MBEDTLS SSL OUT CONTENT LEN

choice
    prompt "TLS bankend choice" 
    default NETWORK_MBEDTLS_TLS_ENABLE
    config NETWORK_MBEDTLS_TLS_ENABLE
        bool "ENANBLE MBEDTLS TLS"
        depends on MBEDTLS
        depends on NETWORK_TCP_ENABLE

    config NETWORK_WOLFSSL_TLS_ENABLE
        bool "ENANBLE WOLFSSL TLS"
        depends on WOLFSSL
        depends on NETWORK_TCP_ENABLE

    
        
endchoice

endif

endmenu
```

## components/utils/Kconfig
```kconfig
menuconfig UTILS
    bool "UTILS"
    default y

if UTILS
    config USE_HEAP_4
        bool "Use freertos heap_4.c  dynamic memory"
        default y
endif
```
