## components/Kconfig
```kconfig
menu "SDK Components"

source "$SDK_BASE/components/nr_micro_shell/Kconfig"
source "$SDK_BASE/components/cJSON/Kconfig"
source "$SDK_BASE/components/lv_drivers/Kconfig"
source "$SDK_BASE/components/miniaudio/Kconfig"
source "$SDK_BASE/components/SDL2/Kconfig"
source "$SDK_BASE/components/lvgl/Kconfig"
source "$SDK_BASE/components/QCBOR/Kconfig"
source "$SDK_BASE/components/opus/Kconfig"
source "$SDK_BASE/components/mbedtls/Kconfig"
source "$SDK_BASE/components/dlg/Kconfig"
source "$SDK_BASE/components/libqrencode/Kconfig"
source "$SDK_BASE/components/LinkSDK/Kconfig"
endmenu
```

## components/lvgl/Kconfig
```kconfig
menuconfig LVGL
    bool "lvgl"
    default y

if LVGL
    config LVGL_EXAMPLES
            bool "enable LVGL_EXAMPLES."
            default n
            depends on LVGL
    config LVGL_DEMOS
            bool "enable LVGL_DEMOS."
            default n
            depends on LVGL
endif
```

## components/nr_micro_shell/Kconfig
```kconfig
menuconfig NR_MICRO_SHELL
    bool "nr_micro_shell"
    default y

if NR_MICRO_SHELL

endif
```
